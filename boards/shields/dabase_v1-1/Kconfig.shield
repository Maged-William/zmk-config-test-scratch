## boards/shields/dabase_v1-1/Kconfig.shield
```kconfig
config SHIELD_DABASE_V11_LEFT
    def_bool $(shields_list_contains,dabase_v1-1_left)

config SHIELD_DABASE_V11_RIGHT
    def_bool $(shields_list_contains,dabase_v1-1_right)
```

## config/west.yml
```yaml
manifest:
  defaults:
    revision: v0.3
  remotes:
    - name: zmkfirmware
      url-base: https://github.com/zmkfirmware
    # Additional modules containing boards/shields/custom code can be listed here as well
    # See https://docs.zephyrproject.org/3.2.0/develop/west/manifest.html#projects
    - name: Maged-William
      url-base: https://github.com/Maged-William
  projects:
    - name: zmk
      remote: zmkfirmware
      import: app/west.yml
    - name: dabasev11-zmk-module
      remote: Maged-William
      revision: main
  self:
    path: config
```
